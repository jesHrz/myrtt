## rt-thread/components/Kconfig
```kconfig
menu "RT-Thread Components"

config RT_USING_COMPONENTS_INIT
    bool 
    default n
    
config RT_USING_USER_MAIN
    bool 
    default n
    
    if RT_USING_USER_MAIN
        config RT_MAIN_THREAD_KERNEL_STACK_SIZE
            int "Set main thread kernel stack size"
            default 2048

        config RT_MAIN_THREAD_USER_STACK_SIZE
            int "Set main thread user stack size"
            default 4096
            
        config RT_MAIN_THREAD_PRIORITY
            int "Set main thread priority" 
            default 4  if RT_THREAD_PRIORITY_8
            default 10  if RT_THREAD_PRIORITY_32
            default 85  if RT_THREAD_PRIORITY_256
    endif

source "$RTT_DIR/components/cplusplus/Kconfig"

source "$RTT_DIR/components/finsh/Kconfig"

source "$RTT_DIR/components/dfs/Kconfig"

source "$RTT_DIR/components/drivers/Kconfig"

source "$RTT_DIR/components/libc/Kconfig"

endmenu
```

## rt-thread/components/syscalls/Kconfig
```kconfig
config RT_USING_SYSCALLS
    bool "Using system call layer"
    select RT_USING_DFS
    select RT_USING_LIBC
    depends on ARCH_ARM_CORTEX_M7 && RT_USING_HEAP
    default n
    help
        The system call layer supply syscalls from RT-Thread to support image seperation.
    
    if RT_USING_SYSCALLS
        config RT_USER_STACK_SIZE
            int "Set thread user stack size"
            default 8192
    endif
```
